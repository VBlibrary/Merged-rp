## app/boards/shields/rgovision/Kconfig.defconfig
```kconfig
## Copyright (c) 2022 ZMK Contributors
# SPDX-License-Identifier: MIT
if SHIELD_RGOVISION

config ZMK_KEYBOARD_NAME
    default "rgovision"

config I2C
    default y

config ZMK_TRACKPAD
    default y
	
endif 
```
